// effente sensor test: MPU6050 readings on the OLED screen.
//
// Both devices are on Wire2 (found by the imu_i2c_scan app): the MPU6050 at 0x68 and the
// OLED at 0x3C. The screen driver is built in (SSD1306/SSD1309 or SH1106 controller, page
// addressing), so no display library has to be downloaded. The same numbers go to the serial
// monitor once a second. A test of the wiring and settings, not the device's data stream.
//
// MPU6050 settings, as recommended in device/intake/source.py: accelerometer +-8 g
// (4096 counts per g), gyroscope +-250 deg/s, digital low-pass 260 Hz, 1 kHz sample rate.

#include <Arduino_RouterBridge.h>
#include <Wire.h>

TwoWire &BUS = Wire2;
const uint8_t MPU_ADDR = 0x68, OLED_ADDR = 0x3C;  // not "MPU": that name is the chip's memory protection unit
const uint8_t OLED_COL_OFFSET = 0;  // 2 for an SH1106 controller (text shifted or cut off at the edge)
const float COUNTS_PER_G = 4096.0f;

// ------------------------------------------------------------------ MPU6050
bool mpuWrite(uint8_t reg, uint8_t val) {
  BUS.beginTransmission(MPU_ADDR);
  BUS.write(reg);
  BUS.write(val);
  return BUS.endTransmission() == 0;
}

int mpuRead(uint8_t reg, uint8_t *buf, uint8_t n) {
  BUS.beginTransmission(MPU_ADDR);
  BUS.write(reg);
  if (BUS.endTransmission(false) != 0) return -1;
  uint8_t got = BUS.requestFrom(MPU_ADDR, n);
  for (uint8_t i = 0; i < got; i++) buf[i] = BUS.read();
  return got;
}

uint8_t whoAmI = 0;

bool mpuBegin() {
  mpuRead(0x75, &whoAmI, 1);           // WHO_AM_I: 0x68 on a real MPU6050
  return mpuWrite(0x6B, 0x01)          // PWR_MGMT_1: wake up, clock from the X gyro
         && mpuWrite(0x1A, 0x00)       // CONFIG: low-pass 260 Hz (accelerometer)
         && mpuWrite(0x19, 7)          // SMPLRT_DIV: 8 kHz / (1 + 7) = 1 kHz
         && mpuWrite(0x1B, 0x00)       // GYRO_CONFIG: +-250 deg/s
         && mpuWrite(0x1C, 0x10);      // ACCEL_CONFIG: +-8 g
}

bool readAccel(float a[3], float g[3], float *tempC) {
  uint8_t b[14];
  if (mpuRead(0x3B, b, 14) != 14) return false;
  for (int i = 0; i < 3; i++) {
    a[i] = (int16_t)((b[2 * i] << 8) | b[2 * i + 1]) / COUNTS_PER_G;
    g[i] = (int16_t)((b[8 + 2 * i] << 8) | b[9 + 2 * i]) / 131.0f;
  }
  *tempC = (int16_t)((b[6] << 8) | b[7]) / 340.0f + 36.53f;
  return true;
}

// ------------------------------------------------------------------ OLED
const uint8_t FONT[96][5] = {  // classic 5x7 font, ASCII 32-127
  {0x00,0x00,0x00,0x00,0x00},{0x00,0x00,0x5F,0x00,0x00},{0x00,0x07,0x00,0x07,0x00},{0x14,0x7F,0x14,0x7F,0x14},
  {0x24,0x2A,0x7F,0x2A,0x12},{0x23,0x13,0x08,0x64,0x62},{0x36,0x49,0x55,0x22,0x50},{0x00,0x05,0x03,0x00,0x00},
  {0x00,0x1C,0x22,0x41,0x00},{0x00,0x41,0x22,0x1C,0x00},{0x08,0x2A,0x1C,0x2A,0x08},{0x08,0x08,0x3E,0x08,0x08},
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  {0x00,0x00,0x7F,0x00,0x00},{0x00,0x41,0x36,0x08,0x00},{0x08,0x08,0x2A,0x1C,0x08},{0x00,0x00,0x00,0x00,0x00},
};

uint8_t fb[8][128];  // 8 pages of 8 rows

void oledCmd(uint8_t c) {
  BUS.beginTransmission(OLED_ADDR);
  BUS.write(0x00);
  BUS.write(c);
  BUS.endTransmission();
}

bool oledBegin() {
  BUS.beginTransmission(OLED_ADDR);
  if (BUS.endTransmission() != 0) return false;
  const uint8_t init[] = {0xAE, 0xD5, 0x80, 0xA8, 0x3F, 0xD3, 0x00, 0x40, 0x8D, 0x14, 0xA1, 0xC8,
                          0xDA, 0x12, 0x81, 0xCF, 0xD9, 0xF1, 0xDB, 0x40, 0xA4, 0xA6, 0xAF};
  for (uint8_t c : init) oledCmd(c);
  return true;
}

void oledShow() {
  for (uint8_t page = 0; page < 8; page++) {
    oledCmd(0xB0 + page);
    oledCmd(0x00 + (OLED_COL_OFFSET & 0x0F));
    oledCmd(0x10 + (OLED_COL_OFFSET >> 4));
    for (uint8_t x = 0; x < 128; x += 16) {
      BUS.beginTransmission(OLED_ADDR);
      BUS.write(0x40);
      for (uint8_t i = 0; i < 16; i++) BUS.write(fb[page][x + i]);
      BUS.endTransmission();
    }
  }
}

void text(uint8_t line, const char *s) {  // 21 characters per line, 8 lines
  memset(fb[line], 0, 128);
  for (uint8_t i = 0; s[i] && i < 21; i++) {
    uint8_t c = (s[i] < 32 || s[i] > 127) ? '?' : s[i];
    memcpy(&fb[line][i * 6], FONT[c - 32], 5);
  }
}

// ------------------------------------------------------------------ numbers
// Formatted by hand: small cores often build snprintf without floating-point support.
char *fnum(char *out, float v, uint8_t dec, bool plus) {
  char *p = out;
  if (v < 0) { *p++ = '-'; v = -v; } else if (plus) { *p++ = '+'; }
  uint32_t scale = 1;
  for (uint8_t i = 0; i < dec; i++) scale *= 10;
  uint32_t n = (uint32_t)(v * scale + 0.5f);
  p += sprintf(p, "%lu", (unsigned long)(n / scale));
  if (dec) p += sprintf(p, ".%0*lu", dec, (unsigned long)(n % scale));
  return out;
}

// ------------------------------------------------------------------ main
bool mpuOk = false, oledOk = false;
float a[3], gy[3], tempC;
float mean[3] = {0, 0, 1}, sumSq = 0, peak = 0;
uint32_t samples = 0, windowN = 0, lastDraw = 0, lastPrint = 0, lastRead = 0, readErrors = 0;
float shownRms = 0, shownPeak = 0;

void setup() {
  Bridge.begin();
  Monitor.begin();
  BUS.begin();
  BUS.setClock(400000);
  mpuOk = mpuBegin();
  oledOk = oledBegin();
  Monitor.print("MPU6050 ");
  Monitor.print(mpuOk ? "ok" : "NOT FOUND");
  Monitor.print(", WHO_AM_I 0x");
  Monitor.print(whoAmI, HEX);
  Monitor.print("; OLED ");
  Monitor.println(oledOk ? "ok" : "NOT FOUND");
}

void loop() {
  uint32_t now = millis();
  if (mpuOk && now - lastRead >= 10) {  // about 100 readings a second for the display test
    lastRead = now;
    if (readAccel(a, gy, &tempC)) {
      samples++;
      float dyn2 = 0;
      for (int i = 0; i < 3; i++) {
        mean[i] += 0.02f * (a[i] - mean[i]);  // slow average = gravity
        float d = a[i] - mean[i];
        dyn2 += d * d;
      }
      sumSq += dyn2;
      windowN++;
      float mag = sqrtf(dyn2);
      if (mag > peak) peak = mag;
    } else {
      readErrors++;
    }
  }
  if (now - lastDraw >= 250) {
    lastDraw = now;
    if (windowN) {
      shownRms = sqrtf(sumSq / windowN);
      shownPeak = peak;
    }
    sumSq = 0;
    windowN = 0;
    peak = 0;
    char line[32], n1[16];
    text(0, "effente sensor test");
    snprintf(line, sizeof line, "ax %s g", fnum(n1, a[0], 3, true)); text(1, line);
    snprintf(line, sizeof line, "ay %s g", fnum(n1, a[1], 3, true)); text(2, line);
    snprintf(line, sizeof line, "az %s g", fnum(n1, a[2], 3, true)); text(3, line);
    snprintf(line, sizeof line, "vib  %s mg rms", fnum(n1, 1000 * shownRms, 1, false)); text(4, line);
    snprintf(line, sizeof line, "peak %s mg", fnum(n1, 1000 * shownPeak, 1, false)); text(5, line);
    snprintf(line, sizeof line, "gyro %s deg/s", fnum(n1, gy[2], 1, true)); text(6, line);
    snprintf(line, sizeof line, "%sC n=%lu", fnum(n1, tempC, 1, false), (unsigned long)samples); text(7, line);
    if (!mpuOk) text(1, "MPU6050 not found");
    if (oledOk) oledShow();
  }
  if (now - lastPrint >= 1000) {
    lastPrint = now;
    char line[128], x[16], y[16], z[16], r[16], pk[16], tc[16];
    snprintf(line, sizeof line, "a %s %s %s g | vib %s mg rms | peak %s mg | %s C | n %lu | errors %lu",
             fnum(x, a[0], 3, true), fnum(y, a[1], 3, true), fnum(z, a[2], 3, true), fnum(r, 1000 * shownRms, 1, false),
             fnum(pk, 1000 * shownPeak, 1, false), fnum(tc, tempC, 1, false), (unsigned long)samples,
             (unsigned long)readErrors);
    Monitor.println(line);
  }
}
